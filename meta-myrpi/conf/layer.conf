## meta-myrpi/conf/layer.conf
```bitbake
# We have a conf and classes directory, add to BBPATH
BBPATH .= ":${LAYERDIR}"

# We have recipes-* directories, add to BBFILES
BBFILES += "${LAYERDIR}/recipes-*/*/*.bb \
            ${LAYERDIR}/recipes-*/*/*.bbappend"

BBFILE_COLLECTIONS += "meta-myrpi"
BBFILE_PATTERN_meta-myrpi = "^${LAYERDIR}/"
BBFILE_PRIORITY_meta-myrpi = "6"

LAYERDEPENDS_meta-myrpi = "core"
LAYERSERIES_COMPAT_meta-myrpi = "gatesgarth"
```
